// Скетч для проверки RFID-RC522 на ESP32-C3
/*
          ┌───┐
  ┌───────┤   ├───────┐ ESP32-C3
  │○ 5v ◘ └───┘ ◘ 10 ○│
  │○ GND GPIO8 PWR 9 ○│
  │○ 3.3v          8 ○│
  │○ RX            7 ○│
  │○ TX ┌───────┐  6 ○│
  │○ 2  │  0.42 │  5 ○│
  │○ 1  │  OLED │  4 ○│
  │○ 0  └───────┘  3 ○│
  │  ◯ BOOT  RST ◯  │
  └───────────────────┘

        ┌─────────────────┐ RFID-RC522
      5 │○ SDA            │
      6 │○ SCK            │
      7 │○ MOSI           │
      8 │○ MISO           │
        │○ IRQ            │
    GND │○ GND            │
     10 │○ RST            │
   3.3v │○ 3V3            │
        └─────────────────┘
*/

#include <SPI.h>
#include <MFRC522.h>

/*
Распиновка
VCC: Питание модуля. Подключать строго к 3.3V на ESP32.
GND: Земля, общий провод.
RST (Reset): Сброс модуля. Можно подключить к любому цифровому пину ESP32.
SDA (или SS): Пин выбора чипа (Chip Select). Нужен, чтобы сказать модулю "сейчас я общаюсь с тобой". Можно использовать любой цифровой пин.
SCK: Тактовый сигнал (Clock). Это стандартный SPI-пин.
MOSI: Линия данных от ESP32 к модулю (Master Out Slave In).
MISO: Линия данных от модуля к ESP32 (Master In Slave Out).
IRQ: пин для прерываний используется редко, в большинстве простых скетчей его можно не подключать
*/

// Определяем НОВЫЕ пины
#define RST_PIN  10  // Новый пин для сброса
#define SS_PIN   5  // Новый пин для SDA (CS)
#define SCK_PIN  6  // Новый пин для SCK
#define MISO_PIN 8  // Новый пин для MISO
#define MOSI_PIN 7  // Новый пин для MOSI

// Создаем объект
MFRC522 mfrc522(SS_PIN, RST_PIN);


void setup() {
  Serial.begin(115200);
  Serial.println("Hello, ESP32-C3!");

  // ГЛАВНОЕ: Инициализируем SPI с КАСТОМНЫМИ пинами
  // Порядок: (sck, miso, mosi, ss)
  SPI.begin(SCK_PIN, MISO_PIN, MOSI_PIN, SS_PIN); 
  mfrc522.PCD_Init(); // Запускаем модуль
  mfrc522.PCD_DumpVersionToSerial(); // Проверяем, что все работает
  Serial.println("MFRC522 Ready");
}

void loop() {
  delay(10);
  // PICC_IsNewCardPresent() опрашивает поле и проверяет:
  // 1) Есть ли вообще какая-то карта в зоне действия
  // 2) Не та ли это же карта, которую мы только что читали
  if (!mfrc522.PICC_IsNewCardPresent()) {
    return; // Нет новой карты - выходим из loop(), ничего не делаем
            // (на следующей итерации проверим снова)
  }
  // PICC_ReadCardSerial() пытается установить связь с картой и считать её уникальный идентификатор (4 или 7 байт)
  // Возвращает true при успешном чтении
  // Выполняет антиколлизию (если несколько карт - выберет одну)
  if (!mfrc522.PICC_ReadCardSerial()) {
    return; // Не удалось прочитать UID (помехи, отвал контакта, карта убрана)
            // Выходим, ничего не выводим
  }

  // ВЫВОД UID В МОНИТОР ПОРТА (СЕРИЙНЫЙ ПОРТ)
  Serial.print("UID:");
  // mfrc522.uid.size - размер UID в байтах:
  // - 4 байта для карт Mifare Classic (1K, 4K)
  // - 7 байт для карт Mifare Ultralight / NTAG
  // - 10 байт для некоторых специфичных карт
  for (byte i = 0; i < mfrc522.uid.size; i++) {
    // Добавляем ":" перед каждым байтом, а если байт меньше 0x10 (16 в десятичной),
    // то вместо ":" выводим ":0" - это добавляет ведущий ноль для читаемости
    // Например: вместо ":A" будет ":0A"
    Serial.print(mfrc522.uid.uidByte[i] < 0x10 ? ":0" : ":");
    // Выводим сам байт UID в шестнадцатеричной системе (HEX)
    // Для 0x12 выведет "12", для 0x0A выведет "A" (но выше мы добавили "0")
    Serial.print(mfrc522.uid.uidByte[i], HEX);
  }
  Serial.println();

  // PICC_HaltA() отправляет карте команду перейти в режим пониженного энергопотребления
  // Это необходимо для:
  // 1) Следующий вызов PICC_IsNewCardPresent() корректно определил, 
  //    что это НОВАЯ карта (а не та же самая)
  // 2) Не перечитывать одну и ту же карту миллион раз в секунду
  // Без этого вызова код будет выдавать UID одной карты непрерывно
  mfrc522.PICC_HaltA();
  delay(1000);
  // После задержки loop() выполнится снова и начнёт искать следующую карту
}