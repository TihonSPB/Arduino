#include "Rfid.h"

#include <SPI.h>
#include <MFRC522.h>

// -------------------
// Настройка пинов
// -------------------

/*
VCC: Питание модуля. Подключать строго к 3.3V на ESP32.
GND: Земля, общий провод.
RST (Reset): Сброс модуля. Можно подключить к любому цифровому пину ESP32.
SDA (или SS): Пин выбора чипа (Chip Select). Нужен, чтобы сказать модулю "сейчас я общаюсь с тобой". Можно использовать любой цифровой пин.
SCK: Тактовый сигнал (Clock). Это стандартный SPI-пин.
MOSI: Линия данных от ESP32 к модулю (Master Out Slave In).
MISO: Линия данных от модуля к ESP32 (Master In Slave Out).
IRQ: пин для прерываний используется редко, в большинстве простых скетчей его можно не подключать
*/

// Определяем НОВЫЕ пины
#define RST_PIN  13  // Новый пин для сброса
#define SS_PIN   8  // Новый пин для SDA (CS)
#define SCK_PIN  9  // Новый пин для SCK
#define MISO_PIN 11  // Новый пин для MISO
#define MOSI_PIN 10  // Новый пин для MOSI

// Создаём объект RFID-считывателя
MFRC522 mfrc522(SS_PIN, RST_PIN);

// -------------------
// Инициализация RFID
// -------------------

void initRFID()
{  
    // Инициализируем SPI с КАСТОМНЫМИ пинами
    // Порядок: (sck, miso, mosi, ss)
    SPI.begin(
        SCK_PIN,
        MISO_PIN,
        MOSI_PIN,
        SS_PIN
    );

    mfrc522.PCD_Init();

    Serial.println("RFID инициализация"); // -------------------DEL-------------------
}

// -------------------
// Чтение UID карты
// -------------------
bool readCard(CardUID& card)
{
    // PICC_IsNewCardPresent() опрашивает поле и проверяет:
    // 1) Есть ли вообще какая-то карта в зоне действия
    // 2) Не та ли это же карта, которую мы только что читали
    if (!mfrc522.PICC_IsNewCardPresent())
    {
        return false;   // Нет новой карты - выходим, возвращает false.
    }

    // PICC_ReadCardSerial() пытается установить связь с картой и считать её уникальный идентификатор (4 или 7 байт)
    // Возвращает true при успешном чтении
    // Выполняет антиколлизию (если несколько карт - выберет одну)
    if (!mfrc522.PICC_ReadCardSerial())
    {
        return false;   // Не удалось прочитать UID (помехи, отвал контакта, карта убрана)
                        // Выходим, возвращает false.
    }

    // mfrc522.uid.size - размер UID в байтах:
    // - 4 байта для карт Mifare Classic (1K, 4K)
    // - 7 байт для карт Mifare Ultralight / NTAG
    // - 10 байт для некоторых специфичных карт
    card.size = mfrc522.uid.size;

    for (byte i = 0; i < card.size; i++)
    {
        card.uid[i] = mfrc522.uid.uidByte[i];
    }

    // Завершаем работу с картой
    // PICC_HaltA() отправляет карте команду перейти в режим пониженного энергопотребления
    // Это необходимо для:
    // 1) Следующий вызов PICC_IsNewCardPresent() корректно определил, 
    //    что это НОВАЯ карта (а не та же самая)
    // 2) Не перечитывать одну и ту же карту миллион раз в секунду
    // Без этого вызова код будет выдавать UID одной карты непрерывно
    mfrc522.PICC_HaltA();

    return true;
}


// --------------------------------------------------
// Преобразование UID в строку
// --------------------------------------------------
// байты:
// 04 A7 12 BC
// превратятся в строку:
// 04:A7:12:BC
String uidToString(const CardUID& card)
{
    String result;

    // Перебираем все байты UID.
    for (byte i = 0; i < card.size; i++)
    {
        // Добавляем разделитель между байтами.
        if (i > 0)
        {
            result += ":";
        }
        // Если число меньше 16,
        // добавляем ведущий ноль.
        // Например: вместо ":A" будет ":0A"
        if (card.uid[i] < 0x10)
        {
            result += "0";
        }
        // Переводим байт в HEX-строку.
        result += String(card.uid[i], HEX);
    }
    // Переводим в верхний регистр
    result.toUpperCase();

    return result;
}